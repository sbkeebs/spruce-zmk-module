## boards/arm/spruce/Kconfig.board
```kconfig
# Spruce board configuration

# Copyright (c) 2024 The ZMK Contributors
# SPDX-License-Identifier: MIT

config BOARD_SPRUCE_LEFT
    bool "Spruce Left"
    depends on SOC_STM32F072XB
    select ZMK_KSCAN_MATRIX_POLLING

config BOARD_SPRUCE_RIGHT
    bool "Spruce Right"
    depends on SOC_STM32F072XB
    select ZMK_KSCAN_MATRIX_POLLING
```

## boards/arm/spruce/Kconfig.defconfig
```kconfig
# Le Chiffre (stm32) board configuration

# Copyright (c) 2020 The ZMK Contributors
# SPDX-License-Identifier: MIT

if BOARD_SPRUCE_LEFT

config BOARD
    default "spruce_left"

config ZMK_KEYBOARD_NAME
    default "Spruce"

config ZMK_USB
    default y

config ZMK_KSCAN_MATRIX_POLLING
    default y

endif # BOARD_SPRUCE_LEFT

if BOARD_SPRUCE_RIGHT

config BOARD
    default "spruce_right"

endif # BOARD_SPRUCE_RIGHT
```
